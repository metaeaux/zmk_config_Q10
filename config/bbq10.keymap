#include <behaviors.dtsi>
#include <dt-bindings/zmk/keys.h>
#include <dt-bindings/zmk/bt.h>
#include <dt-bindings/zmk/outputs.h>
#include <dt-bindings/zmk/mouse.h>
#include <dt-bindings/zmk/backlight.h>
#include <dt-bindings/zmk/ext_power.h>

#include "zmk-helpers/helper.h"

// LAYERS
#define BASE 0
#define WORD 1
#define ARROW 2
#define NUM 3
#define FUNC 4
#define NAV 5
#define SYS 6

#define __ &trans
#define LMEH LS(LA(LCTL))
#define RMEH RS(RA(RCTL))

#define KP_L &kp LEFT
#define KP_D &kp DOWN
#define KP_U &kp UP
#define KP_R &kp RIGHT
#define SEL_L &kp LS(LEFT)
#define SEL_D &kp LS(DOWN)
#define SEL_U &kp LS(UP)
#define SEL_R &kp LS(RIGHT)

#define BRDN &kp C_BRI_DN
#define BRUP &kp C_BRI_UP
#define VOLDN &kp C_VOL_DN
#define VOLUP &kp C_VOL_UP
#define BT(X) &bt BT_SEL X

#define NSPC &kp LG(PG_DN)
#define PSPC &kp LG(PG_UP)
#define MV_NSPC &kp LS(LG(PG_DN))
#define MV_PSPC &kp LS(LG(PG_UP))
#define BACK LG(LBKT)
#define FORWARD LG(RBKT)
#define PTAB LC(LS(TAB))
#define NTAB LC(TAB)

#define HLP(X) &hm LCTRL X
#define HLR(X) &hm LALT  X
#define HLM(X) &hm LGUI  X
#define HLI(X) &hm LSHFT X

#define HRP(X) &hm RCTRL X
#define HRR(X) &hm RALT  X
#define HRM(X) &hm RGUI  X
#define HRI(X) &hm RSHFT X

#define SH(X) &sh LG(X) X
#define TTY(X) &sh LA(LC(X)) X
#define WR1(X) &wrap1 X
#define KPWR(X) &kp_wrap X X
#define DBLE(X) &kp_dble X X
#define PAR &wrap2 LPAR RPAR
#define BRC &wrap2 LBRC RBRC
#define BKT &wrap2 LBKT RBKT
#define ABKT &wrap2 LT GT

&sk {
    release-after-ms = <1000>;
    quick-release;
};

// HOLD-TAP
ZMK_HOLD_TAP(hm,
     flavor = "tap-preferred";
     tapping-term-ms = <200>;
     quick-tap-ms = <180>;
     require-prior-idle-ms = <125>;
     bindings = <&kp>, <&kp>;
)
ZMK_HOLD_TAP(sh,
     flavor = "tap-preferred";
     tapping-term-ms = <250>;
     quick-tap-ms = <180>;
     require-prior-idle-ms = <125>;
     bindings = <&kp>, <&kp>;
)
ZMK_HOLD_TAP(ltt,
     flavor = "tap-preferred";
     tapping-term-ms = <200>;
     quick-tap-ms = <180>;
     bindings = <&mo>, <&kp>;
)
ZMK_HOLD_TAP(kpsk,
     flavor = "tap-preferred";
     tapping-term-ms = <200>;
     quick-tap-ms = <180>;
     bindings = <&kp>, <&sk>;
)
ZMK_HOLD_TAP(kpsl,
     flavor = "tap-preferred";
     tapping-term-ms = <200>;
     quick-tap-ms = <180>;
     bindings = <&kp>, <&sl>;
)

// CAPS-WORD
ZMK_CAPS_WORD(cap_word,
     mods = <MOD_LSFT>;
     continue-list = <UNDERSCORE MINUS FSLH BKSP DEL LEFT RIGHT UP DOWN>;
)
ZMK_AUTO_LAYER(number_word,
     continue-list = <SEMI MINUS PLUS EQUAL COLON UNDERSCORE TILDE FSLH COMMA DOT BKSP DEL LEFT RIGHT UP DOWN>;
     ignore-numbers;
)
ZMK_AUTO_LAYER(func_word,
     continue-list = <LPAR RPAR LBKT RBKT LBRC RBRC LT GT SPACE EQUAL EXCL DLLR COLON END MINUS LEFT>;
)
ZMK_AUTO_LAYER(arrow,
     continue-list = <LEFT RIGHT UP DOWN>;
     ignore-modifiers;
)

ZMK_MACRO(arrow_left,
     wait-ms = <0>;
     tap-ms = <5>;
     bindings = <&macro_press &kp LEFT>,
	<&macro_pause_for_release>,
	<&macro_release &kp LEFT>,
	<&macro_tap &arrow ARROW>;
)
ZMK_MACRO(arrow_right,
     wait-ms = <0>;
     tap-ms = <5>;
     bindings = <&macro_press &kp RIGHT>,
	<&macro_pause_for_release>,
	<&macro_release &kp RIGHT>,
	<&macro_tap &arrow ARROW>;
)
ZMK_MACRO(arrow_up,
     wait-ms = <0>;
     tap-ms = <5>;
     bindings = <&macro_press &kp UP>,
	<&macro_pause_for_release>,
	<&macro_release &kp UP>,
	<&macro_tap &arrow ARROW>;
)
ZMK_MACRO(arrow_down,
     wait-ms = <0>;
     tap-ms = <5>;
     bindings = <&macro_press &kp DOWN>,
	<&macro_pause_for_release>,
	<&macro_release &kp DOWN>,
	<&macro_tap &arrow ARROW>;
)

// MOD-MORPH
ZMK_MOD_MORPH(sft_tab,
     bindings = <&kpsk RMEH RSFT>, <&kp TAB>;
     mods = <(MOD_LSFT|MOD_LCTL|MOD_LALT|MOD_LGUI)>;
     keep-mods = <(MOD_LCTL|MOD_LALT|MOD_LGUI)>;
)
ZMK_MOD_MORPH(num_stab,
     bindings = <&kpsl RMEH NUM>, <&kp LS(TAB)>;
     mods = <(MOD_LSFT|MOD_LCTL|MOD_LALT|MOD_LGUI)>;
     keep-mods = <(MOD_LCTL|MOD_LALT|MOD_LGUI)>;
)
ZMK_MOD_MORPH(nav_spc_tab,
     bindings = <&ltt NAV SPACE>, <&kp TAB>;
     mods = <(MOD_LSFT)>; // left hand only
)
ZMK_MOD_MORPH(dot_excl,
     bindings = <SH(DOT)>, <DBLE(EXCL)>;
     mods = <(MOD_LSFT|MOD_RSFT)>;
)
ZMK_MOD_MORPH(comma_semicolon,
     bindings = <SH(COMMA)>, <SH(SEMI)>;
     mods = <(MOD_LSFT|MOD_RSFT)>;
)

// MACROS
ZMK_MACRO(begin_cap_word,
     wait-ms = <0>;
     bindings = <&to WORD &cap_word>;
)
ZMK_MACRO(end_cap_word,
     wait-ms = <0>;
     bindings = <&kp K_CANCEL &to BASE>;
)
ZMK_MACRO_ONE_PARAM(dble,
     wait-ms = <10>;
     bindings = <&macro_param_1to1>, <&kp MACRO_PLACEHOLDER>, <&macro_param_1to1>, <&kp MACRO_PLACEHOLDER>;
)
ZMK_MACRO_ONE_PARAM(wrap1,
     wait-ms = <10>;
     bindings = <&macro_param_1to1>, <&kp MACRO_PLACEHOLDER>, <&macro_param_1to1>, <&kp MACRO_PLACEHOLDER &kp LEFT>;
)
ZMK_MACRO_TWO_PARAM(wrap2,
     wait-ms = <10>;
     bindings = <&macro_param_1to1>, <&kp MACRO_PLACEHOLDER>, <&macro_param_2to1>, <&kp MACRO_PLACEHOLDER &kp LEFT>;
)
ZMK_HOLD_TAP(kp_wrap,
     flavor = "tap-preferred";
     tapping-term-ms = <200>;
     quick-tap-ms = <180>;
     bindings = <&wrap1>, <&kp>;
)
ZMK_HOLD_TAP(kp_dble,
     flavor = "tap-preferred";
     tapping-term-ms = <200>;
     quick-tap-ms = <180>;
     bindings = <&dble>, <&kp>;
)

ZMK_MACRO(arrow1,
     wait-ms = <10>;
     bindings = <&kp SPACE &kp EQUAL &kp GT &kp SPACE>;
)
ZMK_MACRO(arrow2,
     wait-ms = <10>;
     bindings = <&kp SPACE &kp MINUS &kp GT &kp SPACE>;
)
ZMK_MACRO(endsemi,
     wait-ms = <10>;
     bindings = <&kp END &kp SEMI>;
)
ZMK_MACRO(shell_arg,
     wait-ms = <10>;
     bindings = <&kp EXCL &kp EXCL &kp COLON &kp DLLR>;
)
ZMK_MOD_MORPH(quote_alt,
     bindings = <KPWR(SQT)>, <KPWR(GRAVE)>;
     mods = <(MOD_LALT|MOD_RALT)>;
)
ZMK_MOD_MORPH(quote,
     bindings = <&quote_alt>, <KPWR(DQT)>;
     mods = <(MOD_LSFT|MOD_RSFT)>;
)


//       0  1  2  3  4         5  6  7  8  9
//      10 11 12 13 14        15 16 17 18 19
//      20 21 22 23 24        25 26 27 28 29
//            30 31 32        33 34
// COMBOS
#undef COMBO_TERM
#define COMBO_TERM 40

// GLOBAL
ZMK_COMBO(combo_base, &to BASE, 31 33, ALL)

#undef COMBO_HOOK
#define COMBO_HOOK require-prior-idle-ms = <120>;
ZMK_COMBO(combo_caps, &begin_cap_word, 13 16, ALL)
ZMK_COMBO(combo_num, &number_word NUM, 12 17, ALL)
ZMK_COMBO(combo_func, &func_word FUNC, 11 18, ALL)
ZMK_COMBO(combo_wezterm, &kp LC(B), 10 19, ALL)

ZMK_COMBO(combo_left_ret, &kp RET, 13 32, ALL)
ZMK_COMBO(combo_left_wezterm, &kp LC(B), 12 31, ALL)
ZMK_COMBO(combo_left_sys, &sl SYS, 10 30, ALL)

ZMK_COMBO(combo_right_sys, &sl SYS, 19 35, ALL)

// FN & NUM LAYER
ZMK_COMBO(combo_left_abkt, ABKT, 16 19, NUM FUNC)
ZMK_COMBO(combo_left_bkt,  BKT,  10 13, NUM FUNC)
ZMK_COMBO(combo_left_par,  PAR, 17 18, NUM FUNC)
ZMK_COMBO(combo_left_brc,  BRC, 11 12, NUM FUNC)

//         --------------------------------------------------------------------------------------------------------------------------         
//         |    Shoulder Key1    |                                                                             |    Shoulder Key2    |     
// |         Call key      |      Blackberry Key        |    Trackpad    |             Back Key                |             Endcall Key          |
// |     Q      |     W    |     E    |     R    |      T      |       Y        |       U        |        I        |       O      |      P        |     
// |     A      |     S    |     D    |     F    |      G      |       H        |       J        |        K        |       L      |      ←        |  
// |     alt    |     Z    |     X    |     C    |      V      |       B        |       N        |        M        |       $      |    Enter      |   
//        |         aA     |         0           |           SPACE              |         SYM         |        aA          |       
//        -----------------------------------------------------------------------------------------------------------------
//
// LAYERS
ZMK_LAYER(home,
                 &mkp LCLK                             &mkp RCLK
                 &kp CLCK     &kp LGUI        &mkp LCLK      &mt ESC K_BACK    &kp TAB
		 SH(Q) SH(W) SH(F) SH(P) SH(B)         SH(J) SH(L) SH(U) SH(Y) &quote
             HLP(A) HLR(R) HLM(S) HLI(T) SH(G)         SH(M) HRI(N) HRM(E) HRR(I) HRP(O)
		 SH(Z) SH(X) SH(C) SH(D) SH(V)         SH(K) SH(H)  &comma_semicolon &dot_excl SH(FSLH)
          &ltt FUNC BKSP &num_stab &nav_spc_tab        &sft_tab &ltt FUNC RET
)

ZMK_LAYER(caps,
				__                     __
				__    __      __       __    __
                                __ __ __ __ __         __ __ __ __ __
                                __ __ __ __ __         __ __ __ __ __
                                __ __ __ __ __         __ __ __ __ __
				      __ __ __         &end_cap_word __
)

ZMK_LAYER(arrow,
				__                     __
				__    __      __       __    __
                               __ __ __ __ __         __ __ __ __ __
                               __ __ __ __ __         __ KP_L KP_D KP_U KP_R
                               __ __ __ __ __         __ __ __ __ __
				     __ __ __         __ __
)

ZMK_LAYER(num,
				__                     __
				__    __      __       __    __
    SH(HOME) SH(AT) SH(HASH) SH(DLLR) SH(PRCNT)         SH(CARET) DBLE(AMPS) SH(STAR) DBLE(PIPE) SH(END)
	     SH(N1) SH(N2) SH(N3) SH(N4) SH(N5)         SH(N6) SH(N7) SH(N8) SH(N9) SH(N0)
SH(TILDE) DBLE(MINUS) DBLE(PLUS) DBLE(EQUAL) DBLE(COLON)        DBLE(BSLH) DBLE(UNDER) __ __ __
                                 __ &tog NUM __         __ __
)

ZMK_LAYER(func,
				__                     __
				__    __      __       __    __
       TTY(F1) TTY(F2) TTY(F3) TTY(F4) TTY(F5)          TTY(F6) TTY(F7) TTY(F8) TTY(F9) TTY(F10)
HLP(LBKT) HLR(LBRC) HLM(RBRC) HLI(RBKT) TTY(F11)          TTY(F12) HRI(LT) HRM(LPAR) HRR(RPAR) HRP(GT)
	&shell_arg &arrow2 &arrow1 &endsemi __          __ __ &kp HOME &kp END __
			       __ &tog FUNC __          &tog FUNC &kp DEL
)

ZMK_LAYER(nav,
				__                     __
				__    __      __       __    __
				__ __ __ __ __         __ __ __ __ __
 HLP(BACK) HLR(PTAB) HLM(NTAB) HLI(FORWARD) __         __ &arrow_left &arrow_down &arrow_up &arrow_right
                      BRDN BRUP VOLDN VOLUP __         __ __ __ __ __
			     &kp LA(DEL) __ __          __ __
)

ZMK_LAYER(sys,
				__                     __
				__    __      __       __    __
				BT(3) BT(2) BT(1) BT(0) BT(4)         __ __ __ __ __ 
			   &bootloader __ __ &sys_reset __         __ &sys_reset __ __ &bootloader
&out OUT_BLE &out OUT_USB &ext_power EP_OFF &ext_power EP_ON &bt BT_CLR         __ __ __ __ __
                                                     __ __ __         __ __
)
